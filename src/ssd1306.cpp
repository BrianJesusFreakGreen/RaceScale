#include "ssd1306.h"

// ---------------------------------------------------------------------------
// 5x7 FONT (ASCII 32-127)
// Source: public domain
// ---------------------------------------------------------------------------
static const uint8_t font5x7[][5] PROGMEM = {
    {0x00,0x00,0x00,0x00,0x00}, // (space)
    {0x00,0x00,0x5F,0x00,0x00}, // !
    {0x00,0x07,0x00,0x07,0x00}, // "
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    {0x44,0x64,0x54,0x4C,0x44}  // z
};

// ---------------------------------------------------------------------------
// Core class
// ---------------------------------------------------------------------------

SSD1306::SSD1306(uint8_t address, uint8_t w, uint8_t h)
    : _addr(address), _width(w), _height(h)
{
    _bufferSize = (_width * _height) / 8;
    buffer = (uint8_t*)malloc(_bufferSize);
}

void SSD1306::begin() {
    Wire.begin();
    clear();

    const uint8_t init[] = {
        0xAE, 0x20,0x00, 0x40, 0xA1, 0xC8, 0x81,0x7F,
        0xA4, 0xA6, 0xD3,0x00, 0xD5,0x80, 0xD9,0xF1,
        0xDA,0x12, 0xDB,0x40, 0x8D,0x14, 0xAF
    };
    sendCommands(init, sizeof(init));
}

void SSD1306::sendCommand(uint8_t cmd) {
    Wire.beginTransmission(_addr);
    Wire.write(0x00);
    Wire.write(cmd);
    Wire.endTransmission();
}

void SSD1306::sendCommands(const uint8_t* cmds, uint16_t count) {
    while (count--) sendCommand(*cmds++);
}

void SSD1306::sendData(const uint8_t* data, uint16_t count) {
    while (count > 0) {
        Wire.beginTransmission(_addr);
        Wire.write(0x40);  // data mode

        // send up to 16 bytes per I2C transaction
        uint8_t n = (count > 16) ? 16 : (uint8_t)count;

        for (uint8_t i = 0; i < n; i++) {
            Wire.write(data[i]);
        }

        Wire.endTransmission();

        data  += n;
        count -= n;
    }
}


void SSD1306::clear() {
    memset(buffer, 0, _bufferSize);
}

void SSD1306::display() {
    sendCommand(0x21); sendCommand(0); sendCommand(_width - 1);
    sendCommand(0x22); sendCommand(0); sendCommand((_height / 8) - 1);
    sendData(buffer, _bufferSize);
}

void SSD1306::drawPixel(int x, int y, bool color) {
    if (x < 0 || x >= _width || y < 0 || y >= _height) return;
    uint16_t i = x + (y / 8) * _width;
    uint8_t b = 1 << (y & 7);
    if (color) buffer[i] |= b;
    else       buffer[i] &= ~b;
}

void SSD1306::drawChar(int x, int y, char c, bool color) {
    if (c < 32 || c > 126) return;
    for (int col = 0; col < 5; col++) {
        uint8_t line = pgm_read_byte(&font5x7[c - 32][col]);
        for (int row = 0; row < 7; row++) {
            drawPixel(x + col, y + row, (line >> row) & 1 ? color : false);
        }
    }
}

void SSD1306::drawString(int x, int y, const char* s, bool color) {
    while (*s) {
        drawChar(x, y, *s++, color);
        x += 6;
    }
}
